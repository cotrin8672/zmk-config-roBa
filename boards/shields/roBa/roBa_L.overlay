#include "roBa.dtsi"

&kscan0 {
        col-gpios
            = <&xiao_d 10 GPIO_ACTIVE_HIGH>
            , <&xiao_d 9 GPIO_ACTIVE_HIGH> 
            , <&xiao_d 8 GPIO_ACTIVE_HIGH> 
            , <&xiao_d 7 GPIO_ACTIVE_HIGH> 
            , <&gpio0 15 GPIO_ACTIVE_HIGH> /* XIAO BLE Plus D11 */
            , <&gpio1 1 GPIO_ACTIVE_HIGH> /* XIAO BLE Plus P1.01 */
            ;
};

&left_encoder {
    status = "okay";
};
