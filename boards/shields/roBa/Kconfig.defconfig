## boards/shields/roBa/Kconfig.defconfig
```kconfig
if SHIELD_ROBA_R

config ZMK_KEYBOARD_NAME
    default "roBa_R"

config ZMK_SPLIT
    default y

config ZMK_SPLIT_ROLE_CENTRAL
    default y

endif

if SHIELD_ROBA_R_TRACKBALL_TEST

config ZMK_KEYBOARD_NAME
    default "roBa_TB"

config ZMK_SPLIT
    default y

config ZMK_SPLIT_ROLE_CENTRAL
    default y

endif

if SHIELD_ROBA_L

config ZMK_KEYBOARD_NAME
    default "roBa_L"

config ZMK_SPLIT
    default y

endif
```

## boards/shields/roBa/Kconfig.shield
```kconfig
config SHIELD_ROBA_R
    def_bool $(shields_list_contains,roBa_R)

config SHIELD_ROBA_R_TRACKBALL_TEST
    def_bool $(shields_list_contains,roBa_R_trackball_test)

config SHIELD_ROBA_L
    def_bool $(shields_list_contains,roBa_L)
```
